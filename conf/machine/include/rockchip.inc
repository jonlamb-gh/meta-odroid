## conf/machine/include/rockchip.inc
```bitbake
# Copyright (C) 2023 Armin Kuster <akuster808@gmail.com>
# Released under the MIT license (see COPYING.MIT for the terms)

require conf/machine/include/soc-family.inc

SERIAL_CONSOLES ?= "1500000;ttyS2"
UBOOT_CONSOLE ?= "console=ttyS2,1500000
```

## conf/machine/odroid-go-ultra.conf
```bitbake
#@TYPE: Machine
#@NAME: odroid-go-ultra
#@DESCRIPTION: Machine configuration for Hardkernel odroid-go ultra gaem console
#@MAINTAINER: Armin Kuster <akuster808@gmail.com>

# Amlogic S922X (Quad-core Cortex-A73(2.2Ghz) and Dual-core Cortex-A53(2Ghz)
# Mali-G52 GPU with 6 x Execution Engines (846Mhz)
Modified EmulationStation front-end with Libretro. GPU accelerated OpenGL-ES on DRM-FB
# 2GiB (LPDDR4 1608Mhz, 32 Bits bus width)
# On board 16GiB eMMC, Micro SD Card slot(UHS-1 Capable interface)
# 5inch 854×480 TFT LCD (Wide viewing angle display, MIPI-DSI interface)
# Audio   Earphone stereo jack, 0.5Watt 8Ω Mono speaker
# Li-Polymer 3.7V/4000mAh(76.5×54.5×7.5mm), Up to 6 hours of continuous game playing time
# Support USB 2.0 Device on the USB-C port
# External I/O    USB 2.0 Host x 1
# Input Buttons   F1, F2, F3, F4, F5, F6, A, B, X, Y, 
# Direction Pad, Left Shoulder, Right Shoulder, Left Shoulder2, Right Shoulder2,
# Analog joystick, Analog joystick2

require conf/machine/odroid-n2l.conf

KERNEL_DEVICETREE = "amlogic/meson-g12b-odroid-go-ultra.dtb"

UBOOT_MACHINE = "odroid-go-ultra_defconfig"
```

## conf/machine/odroid-go3.conf
```bitbake
#@TYPE: Machine
#@NAME: odroid-go3
#@DESCRIPTION: Machine configuration for Hardkernel odroid-go super game console 
#@MAINTAINER: Armin Kuster <akuster808@gmail.com>

# RockChip RK3326(Quad-Core ARM 64bit Cortex-A35 1.3GHz)
# Mali-G31 MP2
# 1GB (DDR3L 786Mhz, 32 Bits bus width)
# SPI Flash(16Mbytes Boot), Micro SD Card slot(UHS-1 Capable interface)
# 5inch 854×480 TFT LCD (Wide viewing angle display, MIPI-DSI interface)
# Earphone stereo jack, 0.5Watt 8Ω Mono speaker
# Li-Polymer 3.7V/4000mAh(76.5×54.5×7.5mm(L*W*T))
# USB 2.0 Host x 1, 10Pin port(I2C, GPIO, IRQ at 3.3Volt)
# Input Buttons   F1, F2, F3, F4, F5, F6, A, B, X, Y
# Direction Pad, Left Shoulder, Right Shoulder, Left Shoulder2, 
# Right Shoulder2, Analog joystick, Analog joystick2 

require conf/machine/rockchip.inc

KERNEL_DEVICETREE = "rockchip/rk3326-odroid-go3.ddtb"

DEVICE_TREE = "odroid-go2_defconfig"
```

## conf/machine/odroid-n2l.conf
```bitbake
#@TYPE: Machine
#@NAME: odroid-n2l
#@DESCRIPTION: Machine configuration for Hardkernel odroid-n2l systems
#@MAINTAINER: Armin Kuster <akuster808@gmail.com>

# Amlogic S922X ARM Cortex-A53 dual-core + Cortex-A73 quad-core SoC
# 4GB DDR4 SDRAM
# HDMI 2.1 4K/60Hz display
# 40-pin GPIO header
# 1 x USB 3.0 Host, 1 x USB USB 2.0 Host
# eMMC, microSD
# MIPI DSI Port

require conf/machine/odroid-n2.conf

KERNEL_DEVICETREE = "amlogic/meson-g12b-odroid-n2l.dtb"

UBOOT_MACHINE = "odroid-n2l_defconfig"
```
